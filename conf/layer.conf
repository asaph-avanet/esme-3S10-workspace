## conf/layer.conf
```bitbake
BBPATH := "${BBPATH}:${LAYERDIR}"
BBFILES := "${BBFILES} ${LAYERDIR}/recipes/*/*.bb"
BBFILE_COLLECTIONS += "workspacelayer"
BBFILE_PATTERN_workspacelayer := "^${LAYERDIR}/"
BBFILE_PRIORITY_workspacelayer := "99"
LAYERSERIES_COMPAT_workspacelayer := "scarthgap"
```
